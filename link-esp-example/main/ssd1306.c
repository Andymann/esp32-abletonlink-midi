#include "ssd1306.h"
#include <string.h>
#include <driver/i2c.h>
#include <freertos/FreeRTOS.h>
#include <freertos/task.h>

#define I2C_PORT     I2C_NUM_0
#define SDA_PIN      21
#define SCL_PIN      22
#define I2C_FREQ_HZ  400000
#define OLED_ADDR    0x3C


// 5x8 ASCII font, chars 0x20–0x7E, column-major, bit0 = top pixel
static const uint8_t font[][5] = {
    {0x00,0x00,0x00,0x00,0x00}, // ' '
    {0x00,0x00,0x5F,0x00,0x00}, // '!'
    {0x00,0x07,0x00,0x07,0x00}, // '"'
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    {0x10,0x08,0x08,0x10,0x08}, // '~'
};

static void oled_cmd(const uint8_t *buf, size_t n)
{
    i2c_cmd_handle_t h = i2c_cmd_link_create();
    i2c_master_start(h);
    i2c_master_write_byte(h, (OLED_ADDR << 1) | I2C_MASTER_WRITE, true);
    i2c_master_write_byte(h, 0x00, true); // Co=0, D/C=0: command stream
    i2c_master_write(h, (uint8_t *)buf, n, true);
    i2c_master_stop(h);
    i2c_master_cmd_begin(I2C_PORT, h, pdMS_TO_TICKS(100));
    i2c_cmd_link_delete(h);
}

static void oled_data(const uint8_t *buf, size_t n)
{
    i2c_cmd_handle_t h = i2c_cmd_link_create();
    i2c_master_start(h);
    i2c_master_write_byte(h, (OLED_ADDR << 1) | I2C_MASTER_WRITE, true);
    i2c_master_write_byte(h, 0x40, true); // Co=0, D/C=1: data stream
    i2c_master_write(h, (uint8_t *)buf, n, true);
    i2c_master_stop(h);
    i2c_master_cmd_begin(I2C_PORT, h, pdMS_TO_TICKS(100));
    i2c_cmd_link_delete(h);
}

void ssd1306_init(void)
{
    i2c_config_t cfg = {
        .mode          = I2C_MODE_MASTER,
        .sda_io_num    = SDA_PIN,
        .scl_io_num    = SCL_PIN,
        .sda_pullup_en = GPIO_PULLUP_ENABLE,
        .scl_pullup_en = GPIO_PULLUP_ENABLE,
        .master        = { .clk_speed = I2C_FREQ_HZ },
        .clk_flags     = 0,
    };
    i2c_param_config(I2C_PORT, &cfg);
    i2c_driver_install(I2C_PORT, I2C_MODE_MASTER, 0, 0, 0);

    static const uint8_t init[] = {
        0xAE,        // display off
        0x20, 0x00,  // horizontal addressing mode
        0xC8,        // COM scan: flip vertical
        0x40,        // display start line = 0
        0x81, 0x7F,  // contrast
        0xA1,        // segment remap: flip horizontal
        0xA6,        // normal (non-inverted) display
        0xA8, 0x3F,  // multiplex ratio: 64 rows
        0xA4,        // output follows GDDRAM
        0xD3, 0x00,  // display offset = 0
        0xD5, 0x80,  // clock: divide=1, osc=8
        0xD9, 0xF1,  // pre-charge: phase1=1, phase2=15
        0xDA, 0x12,  // COM pins: alternating, no remap (128x64)
        0xDB, 0x40,  // VCOMH deselect level
        0x8D, 0x14,  // charge pump on
        0xAF,        // display on
    };
    oled_cmd(init, sizeof(init));
}

void ssd1306_clear(void)
{
    static const uint8_t zeros[128] = {0};
    for (uint8_t page = 0; page < 8; page++) {
        uint8_t pos[] = { 0x21, 0, 127, 0x22, page, page };
        oled_cmd(pos, sizeof(pos));
        oled_data(zeros, sizeof(zeros));
    }
}

void ssd1306_write_string(uint8_t row, const char *str, bool center, uint8_t scale_x, uint8_t scale_y)
{
    if (scale_x < 1) scale_x = 1;
    if (scale_x > 8) scale_x = 8;
    if (scale_y < 1) scale_y = 1;
    if (scale_y > 8) scale_y = 8;

    uint8_t max_rows = 8 / scale_y;
    if (row >= max_rows) return;

    uint8_t start_page = row * scale_y;
    uint8_t char_w = (uint8_t)(6 * scale_x); // 5 cols × scale_x + scale_x spacing

    int len = (int)strlen(str);
    int col = center ? (128 - len * char_w) / 2 : 0;
    if (col < 0) col = 0;

    int draw_w = len * char_w;
    if (col + draw_w > 128) draw_w = 128 - col;
    if (draw_w <= 0) return;

    uint8_t end_col = (uint8_t)(col + draw_w - 1);

    for (int pg = 0; pg < scale_y; pg++) {
        uint8_t buf[128] = {0};
        int x = 0;

        for (int i = 0; i < len; i++) {
            char c = str[i];
            if (c < 0x20 || c > 0x7E) c = ' ';
            const uint8_t *glyph = font[(uint8_t)(c - 0x20)];

            for (int j = 0; j < 5; j++) {
                uint8_t b = glyph[j];

                uint8_t page_byte = 0;
                for (int bp = 0; bp < 8; bp++) {
                    int src_bit = (pg * 8 + bp) / scale_y;
                    if (src_bit < 8 && (b & (1u << src_bit))) {
                        page_byte |= (1u << bp);
                    }
                }

                for (int sx = 0; sx < scale_x; sx++) {
                    int px = x + sx;
                    if (px < draw_w) buf[px] = page_byte;
                }
                x += scale_x;
            }
            x += scale_x; // inter-character spacing
        }

        uint8_t page = start_page + (uint8_t)pg;
        uint8_t pos[] = { 0x21, (uint8_t)col, end_col, 0x22, page, page };
        oled_cmd(pos, sizeof(pos));
        oled_data(buf, draw_w);
    }
}
